#pragma once
// SSD1306 128x64 por I2C sin librerias externas (Adafruit_SSD1306 no compila en el core Zephyr del UNO Q)
#include <Arduino.h>
#include <Wire.h>

#define SSD1306_WHITE 1
#define SSD1306_SWITCHCAPVCC 0x02

static const uint8_t FUENTE[] = {
  0x00,0x00,0x00,0x00,0x00,
  0x00,0x00,0x5F,0x00,0x00,
  0x00,0x07,0x00,0x07,0x00,
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  0x08,0x08,0x2A,0x1C,0x08
};

class Oled : public Print {
 public:
  Oled(uint8_t w, uint8_t h, TwoWire *bus, int8_t rst) : w_(w), h_(h), bus_(bus) {}

  bool begin(uint8_t, uint8_t dir, bool girar = false) {
    dir_ = dir;
    const uint8_t ini[] = {0xAE, 0xD5, 0x80, 0xA8, 0x3F, 0xD3, 0x00, 0x40, 0x8D, 0x14,
                           0x20, 0x00, uint8_t(girar ? 0xA0 : 0xA1), uint8_t(girar ? 0xC0 : 0xC8),
                           0xDA, 0x12, 0x81, 0xCF, 0xD9, 0xF1, 0xDB, 0x40, 0xA4, 0xA6, 0xAF};
    for (uint8_t c : ini) cmd(c);
    clearDisplay();
    display();
    return true;
  }

  void clearDisplay() { memset(buf_, 0, sizeof(buf_)); }
  void setTextSize(uint8_t) {}
  void setTextColor(uint8_t) {}
  void setCursor(int16_t x, int16_t y) { x_ = x; y_ = y; }

  void pixel(int16_t x, int16_t y) {
    if (x < 0 || y < 0 || x >= w_ || y >= h_) return;
    buf_[x + (y / 8) * w_] |= 1 << (y & 7);
  }

  void drawLine(int16_t x0, int16_t y0, int16_t x1, int16_t y1, uint8_t) {
    int16_t dx = abs(x1 - x0), dy = -abs(y1 - y0);
    int16_t sx = x0 < x1 ? 1 : -1, sy = y0 < y1 ? 1 : -1, e = dx + dy;
    while (true) {
      pixel(x0, y0);
      if (x0 == x1 && y0 == y1) break;
      int16_t e2 = 2 * e;
      if (e2 >= dy) { e += dy; x0 += sx; }
      if (e2 <= dx) { e += dx; y0 += sy; }
    }
  }

  size_t write(uint8_t c) override {
    if (c == '\n') { x_ = 0; y_ += 8; return 1; }
    if (c == '\r') return 1;
    if (x_ + 6 > w_) { x_ = 0; y_ += 8; }
    if (c < 32 || c > 126) c = '?';
    const uint8_t *g = &FUENTE[(c - 32) * 5];
    for (uint8_t i = 0; i < 5; i++)
      for (uint8_t b = 0; b < 8; b++)
        if (g[i] & (1 << b)) pixel(x_ + i, y_ + b);
    x_ += 6;
    return 1;
  }
  using Print::write;

  void display() {
    cmd(0x21); cmd(0); cmd(w_ - 1);
    cmd(0x22); cmd(0); cmd(h_ / 8 - 1);
    for (uint16_t i = 0; i < sizeof(buf_); i += 16) {
      bus_->beginTransmission(dir_);
      bus_->write(0x40);
      bus_->write(&buf_[i], 16);
      bus_->endTransmission();
    }
  }

 private:
  void cmd(uint8_t c) {
    bus_->beginTransmission(dir_);
    bus_->write(0x00);
    bus_->write(c);
    bus_->endTransmission();
  }

  uint8_t w_, h_, dir_ = 0x3C;
  TwoWire *bus_;
  int16_t x_ = 0, y_ = 0;
  uint8_t buf_[128 * 64 / 8];
};
